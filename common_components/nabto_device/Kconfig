## common_components/nabto_device/Kconfig
```kconfig
menu "Nabto Edge"
    config ENABLE_NABTO_DEVICE
        bool "Enable the nabto device"
        default  "y"
        select MBEDTLS_SSL_PROTO_DTLS
        help
            "Enable Nabto device"
    config NABTO_DEVICE_FUTURE_QUEUE_THREAD_STACK_SIZE
        int "Nabto Future Queue Thread Stack Size"
        default 1024
        depends on ENABLE_NABTO_DEVICE
        help
            "set the stack size of the thread which resolves callbacks set by nabto_device_future_set_callback"
    config NABTO_DEVICE_EVENT_QUEUE_THREAD_STACK_SIZE
        int "Nabto Event Queue Thread Stack Size"
        default 8192
        depends on ENABLE_NABTO_DEVICE
        help
            "Set the stack size for the thread which runs all the core operations."
    config NABTO_DEVICE_NETWORK_THREAD_STACK_SIZE
        int "Nabto Network Thread Stack Size"
        default 2048
        depends on ENABLE_NABTO_DEVICE
        help
            "Set the stack size for the thread which runs the network."

endmenu
```

## components/nabto_esp32_example/Kconfig
```kconfig
menu "Nabto Example"

    config NABTO_DEVICE_ID
    	string "Nabto Device ID"
    	default "de-abcdefgh"
   		help
    		Enter the Nabto id - you can get one by signing up to the nabto console

    config NABTO_PRODUCT_ID
   		string "Nabto product ID"
   		default "pr-abcdefgh"
   		help
    		Enter the product id - you can get one by signing up to the nabto conole

    config NABTO_PRIVATE_KEY
   		string "Nabto private key from edge_key_tool --create-key"
   		default ""
   		help
    		Enter the nabto private key - a private key can be generated by the edge_key_tool


    menu "WiFi"
        config ESP_WIFI_SSID
            string "WiFi SSID"
            default "myssid"
            help
                SSID (network name) for the example to connect to.

        config ESP_WIFI_PASSWORD
            string "WiFi Password"
            default "mypassword"
            help
                WiFi password (WPA or WPA2) for the example to use.
    endmenu

endmenu
```

## examples/audio-demo/main/Kconfig.projbuild
```kconfig
menu "TCP stream server configuration"

config EXAMPLE_NABTO_PRODUCT_ID
    string "Nabto Product ID from https://console.cloud.nabto.com e.g. pr-..."
    default ""
    help
    Enter the product id - you can get one by signing up to the nabto conole

config EXAMPLE_NABTO_DEVICE_ID
    string "Nabto Device ID from https://console.cloud.nabto.com e.g. de-..."
    default ""
    help
    Enter the Nabto id - you can get one by signing up to the nabto console
 
config EXAMPLE_NABTO_RAW_PRIVATE_KEY
    string "Nabto Raw Private Key from https://github.com/nabto/edge-key-tool"
    default ""
    help
    Enter the raw private key as a hex string which is 64 characters long - a raw private key can be generated by the edge_key_tool from https://github.com/nabto/edge-key-tool 

config EXAMPLE_PAIRPASS
    string "Pairing password for the pairing string"
    default "pairpsw"
    help
    Enter the pairing password you wan to use for the device
 

config EXAMPLE_WIFI_SSID
    string "WiFi SSID"
    default "myssid"
    help
        SSID (network name) for the camera to connect to.

config EXAMPLE_WIFI_PASSWORD
    string "WiFi Password"
    default "mypassword"
    help
        WiFi password (WPA or WPA2) for the camera to use.

endmenu
```

## examples/audio-demo/sdkconfig.defaults
```kconfig
CONFIG_ESP_LYRAT_MINI_V1_1_BOARD=y
CONFIG_SPIRAM=y
CONFIG_SPIRAM_TRY_ALLOCATE_WIFI_LWIP=y
CONFIG_SPIRAM_BOOT_INIT=y
CONFIG_SPIRAM_ALLOW_STACK_EXTERNAL_MEMORY=y
CONFIG_FREERTOS_ENABLE_BACKWARD_COMPATIBILITY=y
CONFIG_PARTITION_TABLE_SINGLE_APP_LARGE=y
CONFIG_ESP_MAIN_TASK_STACK_SIZE=16384
```

## examples/esp-eye-camera/main/Kconfig.projbuild
```kconfig
menu "ESP32 RTSP Configuration"

    config EXAMPLE_NABTO_PRODUCT_ID
        string "Nabto Product ID from https://console.cloud.nabto.com e.g. pr-..."
        default ""
        help
        Enter the product id - you can get one by signing up to the nabto conole

    config EXAMPLE_NABTO_DEVICE_ID
        string "Nabto Device ID from https://console.cloud.nabto.com e.g. de-..."
        default ""
        help
        Enter the Nabto id - you can get one by signing up to the nabto console
    
    config EXAMPLE_NABTO_RAW_PRIVATE_KEY
        string "Nabto Raw Private Key from https://github.com/nabto/edge-key-tool"
        default ""
        help
        Enter the raw private key as a hex string which is 64 characters long - a raw private key can be generated by the edge_key_tool from https://github.com/nabto/edge-key-tool 

    config EXAMPLE_WIFI_SSID
        string "WiFi SSID"
        default "myssid"
        help
            SSID (network name) for the camera to connect to.

    config EXAMPLE_WIFI_PASSWORD
        string "WiFi Password"
        default "mypassword"
        help
            WiFi password (WPA or WPA2) for the camera to use.

    config CAM_VERTICAL_FLIP
        bool "Vertical flip"
        default y
        help
            Vertically flip the camera image.

    config CAM_HORIZONTAL_MIRROR
        bool "Horizontal mirror"
        default y
        help
            Horizontally mirrors the camera image.

    config CAM_FRAMERATE
        int "Frames per second"
        default 8
        help
            Frames per second the camera should run at.

    choice
        prompt "Camera frame size"
        default FRAMESIZE_QVGA

        config FRAMESIZE_QVGA
            bool "QVGA (320x240)"

        config FRAMESIZE_CIF
            bool "CIF (400x296 subsampled)"

        config FRAMESIZE_VGA
            bool "VGA (640x480)"

        config FRAMESIZE_SVGA
            bool "SVGA (800x600 subsampled)"

        config FRAMESIZE_XGA
            bool "XGA (1024x768)"

        config FRAMESIZE_SXGA
            bool "SXGA (1280x1024)"

        config FRAMESIZE_UXGA
            bool "UXGA (1600x1200)"
    endchoice
endmenu
```

## examples/tcptunnel/main/Kconfig.projbuild
```kconfig
menu "Example Configuration"

    config EXAMPLE_NABTO_PRODUCT_ID
   		string "Nabto Product ID from https://console.cloud.nabto.com e.g. pr-..."
   		default ""
   		help
    		Enter the product id - you can get one by signing up to the nabto conole

    config EXAMPLE_NABTO_DEVICE_ID
    	string "Nabto Device ID from https://console.cloud.nabto.com e.g. de-..."
    	default ""
   		help
    		Enter the Nabto id - you can get one by signing up to the nabto console
    
    config EXAMPLE_NABTO_RAW_PRIVATE_KEY
   		string "Nabto Raw Private Key from https://github.com/nabto/edge_key_tool"
   		default ""
   		help
    		Enter the raw private key as a hex string which is 64 characters long - a raw private key can be generated by the edge_key_tool from https://github.com/nabto/edge_key_tool  

    config EXAMPLE_WIFI_SSID
        string "WiFi SSID"
        default ""
        help
            SSID (network name) for the example to connect to.

    config EXAMPLE_WIFI_PASSWORD
        string "WiFi Password"
        default ""
        help
            WiFi password (WPA or WPA2) for the example to use.
endmenu
```

## examples/tcptunnel/sdkconfig.defaults
```kconfig
CONFIG_PARTITION_TABLE_SINGLE_APP_LARGE=y
CONFIG_ESP_MAIN_TASK_STACK_SIZE=8192
CONFIG_SPIRAM=y
CONFIG_SPIRAM_TRY_ALLOCATE_WIFI_LWIP=y
```

## examples/tcptunnel2/sdkconfig.defaults
```kconfig
CONFIG_ESP_MAIN_TASK_STACK_SIZE=23584
CONFIG_PTHREAD_TASK_STACK_SIZE_DEFAULT=8192
```

## examples/thermostat/main/Kconfig
```kconfig
menu "Nabto Thermostat"

    config NABTO_THERMOSTAT_POWER_LED
    	int "Power status LED GPIO number"
    	default 21
   		help
    		Enter the GPIO number which is used to show the power status

endmenu
```

## examples/thermostat/main/Kconfig.projbuild
```kconfig
menu "Example Configuration"

    config EXAMPLE_NABTO_PRODUCT_ID
   		string "Nabto product ID from https://console.cloud.nabto.com e.g. pr-..."
   		default ""
   		help
    		Enter the product id - you can get one by signing up to the nabto conole

    config EXAMPLE_NABTO_DEVICE_ID
    	string "Nabto Device ID from https://console.cloud.nabto.com e.g. de-..."
    	default ""
   		help
    		Enter the Nabto id - you can get one by signing up to the nabto console
    
    config EXAMPLE_NABTO_PRIVATE_KEY
   		string "Nabto private key from https://github.com/nabto/edge_key_tool"
   		default ""
   		help
    		Enter the private key as a raw hex string which is 64 characters long - a private key can be generated by the edge_key_tool from https://github.com/nabto/edge_key_tool  

    config EXAMPLE_WIFI_SSID
        string "WiFi SSID"
        default ""
        help
            SSID (network name) for the example to connect to.

    config EXAMPLE_WIFI_PASSWORD
        string "WiFi Password"
        default ""
        help
            WiFi password (WPA or WPA2) for the example to use.

    config EXAMPLE_THERMOSTAT_POWER_LED
    	int "Power status LED GPIO number"
    	default 21
   		help
    		Enter the GPIO number which is used to show the power status

endmenu
```

## simple/main/Kconfig.projbuild
```kconfig
menu "Nabto 5 example configuration"

	config SSID
		string "WIFI access point name (SSID)"
		default "myaccesspoint"
		help
			Enter the name of the WIFI access point

	config SSID_PASSWORD
		string "WIFI password"
		default "12345678"
		help
			Enter ssid password


	config NABTO_DEVICE
		string "Nabto Device ID"
		default "de-abcdefgh"
		help
			Enter the Nabto id - you can get one by signing up to the nabto console
		
	config NABTO_PRODUCT
		string "Nabto product ID"
		default "pr-abcdefgh"
		help
			Enter the product id - you can get one by signing up to the nabto conole



endmenu
```

## simple/sdkconfig.defaults
```kconfig
CONFIG_MBEDTLS_SSL_PROTO_DTLS=y
CONFIG_ESP_MAIN_TASK_STACK_SIZE=23584
CONFIG_PTHREAD_TASK_STACK_SIZE_DEFAULT=8192
```

## tcptunnel/main/Kconfig.projbuild
```kconfig
menu "Nabto 5 example configuration"

	config SSID
		string "WIFI access point name (SSID)"
		default "myaccesspoint"
		help
			Enter the name of the WIFI access point

	config SSID_PASSWORD
		string "WIFI password"
		default "12345678"
		help
			Enter ssid password


	config NABTO_DEVICE
		string "Nabto Device ID"
		default "de-abcdefgh"
		help
			Enter the Nabto id - you can get one by signing up to the nabto console
		
	config NABTO_PRODUCT
		string "Nabto product ID"
		default "pr-abcdefgh"
		help
			Enter the product id - you can get one by signing up to the nabto conole

	config NABTO_SERVER
		string "Nabto basestation/server hostname" 
		default "pr-aaaaaaaa.devices.dev.nabto.net"
		help
			Enter the hostname of the basestation cluster

	config NABTO_CLIENT_SERVERKEY
		string "The app's server key to be used" 
		default "sk-cccccccccccccccccccccccccccccccc"
		help
			Enter the app's serverkey

	config NABTO_CLIENT_SERVERURL
		string "The app's server url to be used" 
		default "https://pr-aaaaaaaa.clients.dev.nabto.net"
		help
			Enter the app's server url to be used

endmenu
```
